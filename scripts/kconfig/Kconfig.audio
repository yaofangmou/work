## scripts/kconfig/Kconfig.audio
```kconfig
menu "Audio Config"

config  HI_ADEC_MAX_INSTANCE
    int "Maximum Audio Instances"
    help
        set Maximum number instances of audio play, available ranges from 1 to 8
    depends on HI3716MV430
    range 1 8
    default 2

menuconfig HI_AUDIO_OUTPUT_SUPPORT
    bool "Audio Output Port"
    default y

config HI_SPDIF_SUPPORT
    bool "SPDIF Support"
    default y if !(HI3716MV430)
    default n if (HI3716MV430)
    depends on HI_AUDIO_OUTPUT_SUPPORT
    help
        when enabled, the kernel driver of SPDIF will be supported

config HI_ADAC_SUPPORT
    bool "ADAC Support"
    default n
    depends on HI_AUDIO_OUTPUT_SUPPORT
    help
        when enabled, the default kernel driver of ADAC (Audio Digital Analog Converter) will be supported

config HI_AENC_SUPPORT
    bool "AENC Support"
    depends on !(HI3716MV430)
    default y
    help
        when enabled, support audio encoder

config HI_ADEC_AUDSPECTRUM_SUPPORT
    bool "Audio Spectrum Support"
    default n
    help
        when enabled, support audio spectrum

config HI_AI_SUPPORT
    bool "AI Support"
    depends on !(HI3716MV430)
    default n
    help
        when enabled, support audio input (for example, audio recorder)

config HI_SND_SMARTVOLUME_SUPPORT
    bool "Auto Volume Control Support"
    default n
    help
        when enabled, adjust the audio volume automatically

config HI_SND_HBRA_PASSTHROUGH_SUPPORT
    bool "SND HBRA passthrough support"
    default n if (HI3716MV410 || HI3716MV420 || HI3716MV430)
    default y
    help
        when enabled, HBRA(TRUEHD DTSHD 7.1LPCM) passthrough is supported
        when not enabled, the memory consuming can be reduced

config HI_SND_PORT_DELAY_SUPPORT
    bool "SND Port Delay Support"
    default n
    help
        when enabled, the audio can be delayed in audio port intentional to sync the audio and video in the case when audio comes faster than video

menuconfig HI_ADAC_CODEC_SUPPORT
    bool "ADAC Codec Support"
    depends on HI_ADAC_SUPPORT

config HI_ADAC_SLIC_SUPPORT
    bool "slic"
    depends on HI_ADAC_CODEC_SUPPORT
    help
        when enabled, telephone audio driver is supported

config HI_ADAC_TVL320AIC31_SUPPORT
    bool "tlv320"
    depends on HI_ADAC_CODEC_SUPPORT
    help
        when enabled, the driver of specific ADAC chip 'TVL320AIC31' can be supported

config HI_ALSA_SUPPORT
    bool "ALSA Support"
    depends on !(HI_BLUETOOTH_SUPPORT)
    default n
    help
        when enabled, ALSA (Advanced Linux Sound Architecture) is supported

config HI_ALSA_LIB_SUPPORT
    bool "ALSA Library Support"
    depends on LINUX_PRODUCT && HI_ALSA_SUPPORT
    default n
    help
        when enabled, the ALSA related libraries will be generated

config HI_ALSA_DRIVER_SUPPORT
    bool "ALSA Driver Support"
    depends on HI_ALSA_SUPPORT
    default n
    help
        when enabled, ALSA related driver will be compiled (into kernel or independent kernel module)

config HI_SND_ALSA_AO_SUPPORT
    bool "ALSA AO Support"
    depends on HI_ALSA_DRIVER_SUPPORT
    default n
    help
        when enabled, audio can be output by ALSA

config HI_SND_ALSA_AI_SUPPORT
    bool "ALSA AI Support"
    depends on HI_ALSA_DRIVER_SUPPORT
    default n
    select HI_AI_SUPPORT
    help
        when enabled, audio can be input by ALSA

config HI_AUDIO_RESAMPLER_SUPPORT
    bool "Audio Resampler Support"
    default n if LINUX_PRODUCT
    default y if ANDROID_PRODUCT
    help
        when enabled, the resampler library will be generated

config HI_SONIC_SUPPORT
    bool "SONIC SUPPORT"
    default n
    help
        when enabled, audio playback rate can be changed

config HI_KARAOKE_SUPPORT
    bool "Karaoke Support"
    depends on ANDROID_PRODUCT
    default y
    select HI_AUDIO_RESAMPLER_SUPPORT
    help
        when enabled, the KARAOKE related libraries will be generated

source "scripts/kconfig/Kconfig.hacodec"

endmenu
```

## scripts/kconfig/Kconfig.cipher
```kconfig
menu "Cipher Config"
    depends on HI3716MV430

config  HI_CIPHER_MULTI_PACKGET_SUPPORT
    bool "Support multi packet"
    default n
    help
        when enabled, Support multi packet encrypt/decrypt

config  HI_CIPHER_AES_CBCMAC_SUPPORT
    bool "Support AES CMAC"
    default n
    help
        when enabled, Support AES-CBC-MAC algorithm

config  HI_CIPHER_HMAC_SUPPORT
    bool "Support HMAC"
    default n
    help
        when enabled, Support HAMC algorithm

config HI_CIPHER_RSA_SUPPORT
    bool "RSA Support"
    default n
    help
        when enabled, Support RSA algorithm

#+++++++++++++++++++++++++++++++++++++
endmenu
#+++++++++++++++++++++++++++++++++++++
```

## scripts/kconfig/Kconfig.crypto
```kconfig
menu "Crypto Config"

source "scripts/kconfig/Kconfig.cipher"

config HI_PLCIPHER_SUPPORT
    bool "PLCipher support"
    depends on HI3796MV200 || HI3716MV430 || HI3716MV450 || ((HI3716MV410 || HI3716MV420) && ADVCA_NAGRA)
    default y
    help
        PLCipher is used to decrypt ts packages in payload mode and then generate clear ts packages

config HI_OPENSSL_SUPPORT
    bool "Openssl Support"
    depends on LINUX_PRODUCT
    default n

endmenu
```

## scripts/kconfig/Kconfig.demux
```kconfig
menu "Demux Config"
    depends on !HI_NVR_SUPPORT

config HI_DEMUX_SUPPORT
    bool
    default y

config HI_DEMUX_POOLBUF_SIZE
    hex "Poolbuf Size"
    depends on HI_DEMUX_SUPPORT
    default 0x200000
    help
        set buffer size of section, pes and post channel.

config HI_DMX_TSBUF_MULTI_THREAD_SUPPORT
    bool "Multithread operate one ts buffer support"
    depends on HI_DEMUX_SUPPORT
    default n
    help
        when enabled, HI_UNF_DMX_GetTSBuffer() and HI_UNF_DMX_PutTSBuffer() will be disabled
        when enabled, HI_UNF_DMX_AcquireTSBuffer(), HI_UNF_DMX_PushTSBuffer() and HI_UNF_DMX_ReleaseTSBuffer() will be enabled.

config HI_DEMUX_INVALID_PES_DROP_SUPPORT
    bool "Drop invalid audio pes package support"
    depends on HI_DEMUX_SUPPORT &&  ADVCA_IRDETO
    default n
    help
       when enabled, invalid pes packages will be dropped

config HI_DMX_DUP_PID_CHANNEL_SUPPORT
    bool "Pid copy support"
    depends on (HI_DEMUX_SUPPORT && (HI3796MV200 || HI3716MV450 || HI3798CV200 || HI3798MV200 || HI3798MV300))
    default n if (HI3796MV200 || HI3716MV450 || HI3798MV200 || HI3798MV300)
    default y if HI3798CV200
    help
        when enabled, Support pid copy

config HI_DMX_PROC_SUPPORT
    bool "Demux proc support"
    depends on (HI_DEMUX_SUPPORT && HI3716MV430)
    default y
    help
       when enabled, Support proc information

config HI_DMX_DESCRAMBLER_SUPPORT
    bool "Demux descrambler support"
    depends on (HI_DEMUX_SUPPORT && HI3716MV430)
    default y
    help
       when enabled, Support demux descrambler feature

config HI_DMX_TSO_SUPPORT
    bool "Demux tso support"
    depends on (HI_DEMUX_SUPPORT && HI3716MV430)
    default y
    help
       when enabled, Support demux tso port

config HI_DMX_REC_SUPPORT
    bool "Demux record support"
    depends on (HI_DEMUX_SUPPORT && HI3716MV430)
    default y
    help
       when enabled, Support ts record
       when disabled, Not Support record interface, but use echo to record ts is still support

config HI_DMX_REC_INDEX_SUPPORT
    bool "Demux record index support"
    depends on HI_DMX_REC_SUPPORT
    default y
    help
       when enabled, Support ts record index feature,default suppor mpeg2, mpeg4, h264, hevc, avs index

config HI_DMX_REC_INDEX_HEVC_SUPPORT
    bool "Demux record hevc index support"
    depends on HI_DMX_REC_INDEX_SUPPORT
    default y
    help
       when enabled, support ts record hevc index feature
       whed disable, only disable hevc index feature

endmenu
```

## scripts/kconfig/Kconfig.env.media
```kconfig
choice
    prompt "Media Type"
    depends on HI_FORCE_ENV_TO_MEDIA

config FORCE_ENV_IN_NAND
    bool "Nand"
    help
        the bootargs is forced to be set to NAND flash

config FORCE_ENV_IN_SPI
    bool "SPI_Flash"
    depends on !(HI3798MV100 || HI3796MV100)
    help
        the bootargs is forced to be set to SPI flash

config FORCE_ENV_IN_EMMC
    bool "eMMC"
    depends on !(HI3716MV410 || HI3716MV430)
    help
        the bootargs is forced to be set to dMMC flash

endchoice
```

## scripts/kconfig/Kconfig.frontend
```kconfig
menuconfig HI_FRONTEND_SUPPORT
    bool "Frontend Support"
    depends on !(HI3798MV100 || HI3798MV310 || HI3798MV300H)
    default y
    help

config  HI_DVBC_SUPPORT
    bool "DVB-C Support"
    depends on HI_FRONTEND_SUPPORT
    default y
    help

source "scripts/kconfig/Kconfig.frontend.dvb_c"

config  HI_DVBS_SUPPORT
    bool "DVB-S/S2 Support"
    depends on HI_FRONTEND_SUPPORT
    default n
    help

source "scripts/kconfig/Kconfig.frontend.dvb_s"

config  HI_DVBT_SUPPORT
    bool "DVB-T/T2/ISDBT/DTMB Support"
    depends on HI_FRONTEND_SUPPORT
    default n
    help

source "scripts/kconfig/Kconfig.frontend.dvb_t"

config HI_SOC_TUNER_CLOCK
    bool "Tuner Clock from Chipset"
    depends on (HI_FRONTEND_SUPPORT && HI3716MV430)
    default n
    help
        If the tuner clock comes from chipset internal clock, please say y, if the tuner clock comes from external crystal oscillator, please say n
```

## scripts/kconfig/Kconfig.graphics
```kconfig
menu "Graphics Config"

config HI_HIGO_SUPPORT
    bool "HIGO Support"
    default y
    depends on LINUX_PRODUCT
    help
        The HiGo is a highly efficient graphics component provided by HiSilicon.
        It makes full use of the acceleration function of chips and provides the basic
        functions required for graphical user interface (GUI) development.


menuconfig HI_DIRECTFB_SUPPORT
    bool "DirectFB Support"
    default y
    depends on LINUX_PRODUCT

config HI_DIRECTFB_MULTI_SUPPORT
    bool "DirectFB Multi Process support"
    default y
    depends on HI_DIRECTFB_SUPPORT

config HI_DIRECTFB_DEBUG_SUPPORT
    bool "DirectFB Debug support"
    help
        enabled debug messages for development
    default n
    depends on HI_DIRECTFB_SUPPORT

config HI_DIRECTFB_CA_SUPPORT
    bool "DirectFB CA Support"
    help
        when enabled, DirectFB module is enhanced only in some specific security cases
    default n
    depends on HI_DIRECTFB_SUPPORT && HI_ADVCA_SUPPORT
config HI_JPEG_MINI_SUPPORT
    bool "support mini jpeg"
    help
        only support basic function for 8+128 system, and if conifg this can not support soft encode,
        if need support more should close this setting.
    default y
    depends on HI3716MV430

config HI_FREETYPE_MINI_SUPPORT
    bool "support mini freetype"
    help
        only support basic function for 8+128 system, if need support more should close this setting.
    default y
    depends on HI3716MV430

config HI_TDE_NODE_BUFFER_SIZE
    hex "KB, Tde NodeBuf Size"
    default 0x10000
    help
        Set the tde node buffer Size, 0x10000 support 42 node, if you want to support more, you can config more size,
        For example: 0x20000 for 85 node.
    depends on HI3716MV430

config HI_GFX2D_SUPPORT
    bool "GFX2D Support"
    help
        GFX2D module is used for 2D graphics accelerating
    default y
    depends on ANDROID_PRODUCT && (HI3798CV200 || HI3798MV200 || HI3798MV200H || HI3798MV300 || HI3798MV300H || HI3798MV310 || HI3796MV200 || HI3716MV450 || HI3716DV110H)

config HI_FB0_SMMU_SUPPORT
    bool
    default n
    depends on HI_SMMU_SUPPORT

config HI_FB1_SMMU_SUPPORT
    bool
    default y
    depends on HI_SMMU_SUPPORT

config HI_FB2_SMMU_SUPPORT
    bool
    default y
    depends on HI_SMMU_SUPPORT

config HI_FB_CAPTURE_BMP_SUPPORT
     bool "Capture ui to bmp picture"
     default y
     help
        When the ui display has problem, you want to check whether the input ui is ok, open this config, and you can
        capture input ui to bmp picture with "echo capture > /proc/msp/hifb0"
     depends on HI3716MV430

config HI_FB_STEREO_SUPPORT
     bool "Stereo UI Support"
     default y
     help
       If you want to display stereo ui, for example: side by side, top by bottom, framepacking, you need open this
       Config.
     depends on HI3716MV430
config HI_FB_SCROLLTEXT_SUPPORT
    bool "Scrolltext Support"
    default y
    depends on HI3716MV430

config  HI_FB_DECOMPRESS_SUPPORT
    bool "DeCompress in FB Support"
    default y
    depends on HI_GFX2D_SUPPORT
    depends on HI3798CV200 || HI3798MV300 || HI3798MV300H || HI3798MV310 || HI3798MV200 || HI3798MV200H || HI3796MV200 || HI3716MV450 || HI3716DV110H

config  HI_HD0_FB_VRAM_SIZE
    int "KB, HD0 FrameBuffer Size"
    default 7200
    help
        set the HD0 FrameBuffer Size, for example:
            for 1280*720, double buffer, ARGB8888 format, the size is calculated as below:
            (1280*720*4*2/1024)KB

config  HI_HD1_FB_VRAM_SIZE
    int "KB, HD1 FrameBuffer Size"
    default 0
    help
        set the HD1 FrameBuffer Size, for example:
            for 1280*720, double buffer, ARGB8888 format, the size is calculated as below:
            (1280*720*4*2/1024)KB

config  HI_HD2_FB_VRAM_SIZE
    int "KB, HD2 FrameBuffer Size"
    default 0
    help
        set the HD2 FrameBuffer Size, for example:
            for 1280*720, double buffer, ARGB8888 format, the size is calculated as below:
            (1280*720*4*2/1024)KB
    depends on !(HI3716MV430)

endmenu
#+++++++++++++++++++++++++++++++++++++++++++++++++++
```

## scripts/kconfig/Kconfig.hiplayer
```kconfig
#+++++++++++++++++++++++++++++++++++++++++++++++++++
menuconfig HI_PLAYER_SUPPORT
    bool "HiPlayer Support"
    default n
    depends on LINUX_PRODUCT
    select HI_CAPTION_SO_SUPPORT
    select HI_OPENSSL_SUPPORT
    select HI_CURL_SUPPORT
    select HI_VDEC_REG_CODEC_SUPPORT if HI3716MV430

#------------------------------------------------
choice
    prompt "HiPlayer Version"
    depends on HI_PLAYER_SUPPORT
    default HI_PLAYER_FULL_SUPPORT

config  HI_PLAYER_FULL_SUPPORT
    bool "HiPlayer Full Support"
config  HI_PLAYER_NORMAL_SUPPORT
    bool "HiPlayer Normal Support"
endchoice
```

## scripts/kconfig/Kconfig.keyprovision
```kconfig
config  HI_KEYPROVISION_SUPPORT
    depends on (HI3796MV200 || HI3716MV430 || HI3716MV450 || HI3798MV300 || HI3798MV200H || HI3798MV300H || HI3798MV310 || HI3716DV110H)
    bool "Keyprovision Support"
    default n
```
