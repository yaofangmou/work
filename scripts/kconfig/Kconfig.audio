## scripts/kconfig/Kconfig.loader
```kconfig
menuconfig HI_UPGRADE_SUPPORT
    bool "Upgrade Support"
    depends on !HI_NVR_SUPPORT
    default n

#------------------------------------------------
choice
    prompt "Loader Type"
    default HI_RECOVERY_SUPPORT     if ANDROID_PRODUCT
    default HI_APPLOADER_SUPPORT    if LINUX_PRODUCT
    depends on HI_UPGRADE_SUPPORT

config HI_RECOVERY_SUPPORT
    bool "Recovery"
    depends on ANDROID_PRODUCT

config HI_APPLOADER_SUPPORT
    bool "AppLoader"

config HI_BOOTLOADER_SUPPORT
    bool "BootLoader"
    depends on (HI3716MV430)

endchoice

config  HI_LOADER_SUPPORT
    bool
    default y
    depends on HI_UPGRADE_SUPPORT && (HI_APPLOADER_SUPPORT || HI_BOOTLOADER_SUPPORT)

#------------------------------------------------

config HI_LOADER_APPLOADER
    bool "Build AppLoader images"
    default n
    depends on HI_UPGRADE_SUPPORT && HI_APPLOADER_SUPPORT

#------------------------------------------------

choice
    prompt "File Protocol"
    default HI_LOADER_PROTOCOL_HISI_FILE
    depends on HI_UPGRADE_SUPPORT && ((HI_APPLOADER_SUPPORT && HI_LOADER_APPLOADER) || (HI_BOOTLOADER_SUPPORT))
config  HI_LOADER_PROTOCOL_HISI_FILE
    bool "Hisi File Protocol"
endchoice

#------------------------------------------------
choice
    prompt "OTA Protocol"
    default HI_LOADER_PROTOCOL_HISI_OTA
    depends on HI_UPGRADE_SUPPORT && ((HI_APPLOADER_SUPPORT && HI_LOADER_APPLOADER) || (HI_BOOTLOADER_SUPPORT)) && HI_FRONTEND_SUPPORT

config  HI_LOADER_PROTOCOL_HISI_OTA
    bool "Hisi OTA Protocol"
config  HI_LOADER_PROTOCOL_SSU_OTA
    bool "SSU OTA Protocol"
endchoice

#------------------------------------------------
choice
    prompt "OSD Language"
    default HI_APPLOADER_OSD_LANG_EN
    depends on HI_UPGRADE_SUPPORT && ((HI_APPLOADER_SUPPORT && HI_LOADER_APPLOADER) || (HI_BOOTLOADER_SUPPORT))

config  HI_APPLOADER_OSD_LANG_EN
    bool "English"

config  HI_APPLOADER_OSD_LANG_CN
    bool "Chinese"
    depends on HI_LOADER_APPLOADER
endchoice

#------------------------------------------------
config  HI_APPLOADER_ANTI_ROLLBACK
    bool "Anti-Rollback Support"
    default y
    depends on HI_UPGRADE_SUPPORT && ((HI_APPLOADER_SUPPORT && HI_LOADER_APPLOADER) || (HI_BOOTLOADER_SUPPORT))

#------------------------------------------------
config  HI_APPLOADER_MODE_USB
    bool "USB Upgrade Support"
    default y
    depends on HI_UPGRADE_SUPPORT && ((HI_APPLOADER_SUPPORT && HI_LOADER_APPLOADER) || (HI_BOOTLOADER_SUPPORT))

#------------------------------------------------
config  HI_APPLOADER_MODE_FS
    bool "FileSystem Upgrade Support"
    default y if HI_APPLOADER_SUPPORT
    default n if HI_BOOTLOADER_SUPPORT
    depends on HI_UPGRADE_SUPPORT && ((HI_APPLOADER_SUPPORT && HI_LOADER_APPLOADER) || (HI_BOOTLOADER_SUPPORT))

#------------------------------------------------
config  HI_APPLOADER_MODE_IP
    bool "IP Upgrade Support"
    default y if HI_APPLOADER_SUPPORT
    default n if HI_BOOTLOADER_SUPPORT
    depends on HI_UPGRADE_SUPPORT && ((HI_APPLOADER_SUPPORT && HI_LOADER_APPLOADER) || (HI_BOOTLOADER_SUPPORT)) && !HI_ADVCA_SUPPORT
    select HI_CURL_SUPPORT

#------------------------------------------------

menuconfig HI_APPLOADER_MODE_OTA
    bool "OTA Upgrade Support"
    default y if HI_APPLOADER_SUPPORT
    default n if HI_BOOTLOADER_SUPPORT
    depends on HI_UPGRADE_SUPPORT && ((HI_APPLOADER_SUPPORT && HI_LOADER_APPLOADER) || (HI_BOOTLOADER_SUPPORT)) && HI_FRONTEND_SUPPORT

#------------------------------------------------
choice
    prompt "Tuner Type"
    default HI_APPLOADER_TUNER_CAB
    depends on HI_APPLOADER_MODE_OTA

config  HI_APPLOADER_TUNER_CAB
    bool "Cable"

config  HI_APPLOADER_TUNER_SAT
    bool "Satellite"

config  HI_APPLOADER_TUNER_DVB_T
  bool "Terrestrial DVB_T"

config  HI_APPLOADER_TUNER_DVB_T2
  bool "Terrestrial DVB_T2"
endchoice

#------------------------------------------------
config  HI_APPLOADER_INITRD_BASE_ADDR
    hex "Initrd filesystem base addr in mkbootimg tool"
    default 0x3500000
    depends on HI_UPGRADE_SUPPORT && (HI_APPLOADER_SUPPORT && HI_LOADER_APPLOADER) && ADVCA_CONAX
    help
    Initrd filesystem base addr in mkbootimg tool,if initrd=0x4500000 in bootargs,here need set it as 0x3500000
    As mkbootimg will add 0x1000000 kernel space before fs position.

source "scripts/kconfig/Kconfig.curl"
```

## scripts/kconfig/Kconfig.pvr
```kconfig
menu "PVR Config"

config HI_PVR_SUPPORT
    bool "PVR Support"
    default y

config HI_PVR_EXTRA_BUF_SUPPORT
    depends on HI_PVR_SUPPORT
    bool "support optimizing the recording"
    help
        use Extra PVR Buffer to optimize the recording but it will increase memory consumption
    default y

config HI_PVR_EXTRA_TSBUF_SIZE
    depends on (HI_PVR_EXTRA_BUF_SUPPORT && HI3716MV430)
    int "Ts Buffer Size(KB)"
    default 4136
    help
       Configure the size of extra TS buffer.This value is preferably an integer multiple of 188 and the minimum value is 940 KB 

config HI_PVR_EXTRA_INDEX_CACHE_NUM
    depends on (HI_PVR_EXTRA_BUF_SUPPORT && HI3716MV430)
    int "Index Cache Size(The number of frames)"
    default 3600
    range 1200 7200
    help
       Configure the number of indexes in the cache,ranging from 1200 to 7200

config HI_PVR_HEVC_SUPPORT
    depends on (HI_PVR_SUPPORT && HI3716MV430)
    bool "support the HEVC streams"
    help
        support the HEVC streams
    default y

config HI_PVR_PID_CHANGE_SUPPORT
    depends on (HI_PVR_SUPPORT && HI3716MV430)
    bool "support changing recorded PIDs dynamic"
    help
        Supports dynamically changing the recorded PIDs if selected
    default y

config HI_PVR_APPEND_RECORD_SUPPORT
    depends on (HI_PVR_SUPPORT && HI3716MV430)
    bool "support appending recording"
    help
        support appending the new recording data to the recorded file if selected
    default y

config HI_PVR_SWITCH_REWIND_SUPPORT
    depends on (HI_PVR_SUPPORT && HI3716MV430)
    bool "support switching timeshift to recording"
    help
        support dynamically switching rewind-record to non-rewind-record if selected
    default y

config HI_PVR_LINEARIZATION_SUPPORT
    depends on (HI_PVR_SUPPORT && HI3716MV430)
    bool "support linearizing the PVR recorded files"
    help
        support linearization the rewind files
    default y

config HI_PVR_POST_PROCESSING_SUPPORT
    depends on (HI_PVR_SUPPORT && HI3716MV430)
    bool "support post processing the recorded files"
    help
        support processing the recorded files, such as delete the file header or tail
    default y

endmenu
```

## scripts/kconfig/Kconfig.vdec
```kconfig
choice
    prompt "VDEC Decoder Capability"
    depends on HI3716MV430
    default HI_VDEC_HD_FULL

config  HI_VDEC_HD_SIMPLE
    bool "H264,MPEG2,MPEG4 Only"
    help
        H264,MPEG2,MPEG4 Support.

config  HI_VDEC_HD_BASIC
    bool "H264,H265,MPEG2,MPEG4 Only"
    help
        H264,H265,MPEG2,MPEG4 Support.

config  HI_VDEC_HD_FULL
    bool "All Support"
    help
        h264/h265/mpeg2/mpeg4/avs/avs+/vp6/vp8/vc1/h263 Support

endchoice

config  HI_VDEC_DECODE_CAPABILITY
    string
    default "HD_FULL"             if HI_VDEC_HD_FULL
    default "HD_SIMPLE"           if HI_VDEC_HD_SIMPLE
    default "HD_BASIC"            if HI_VDEC_HD_BASIC

config HI_VIDEO_MAX_REF_FRAME_NUM
    int "Max Reference Frame Number(3-16)"
    depends on (HI3716MV410 || HI3716MV420 || HI3716MV430 || HI3798MV100 || HI3796MV100)
    range 3 16
    default 6 if !HI3716MV430
    default 4 if HI3716MV430
    help
        set Max reference frame number, ranges from 3 to 16

config HI_VIDEO_MAX_DISP_FRAME_NUM
    int "Max Display Frame Number(2-16)"
    range 2 16
    default 4 if !HI3716MV430
    default 3 if HI3716MV430
    help
        set Max display frame number, ranges from 2 to 16

config HI_VIDEO_EXTRA_PVR_FRAME_NUM
    int "Extra Frame Number for PVR Fast Backward(0-25)"
    range 0 25
    depends on HI3716MV430
    default 0
    help
        set extra frame number for PVR fast backward, ranges from 0 to 25

config HI_VDEC_MJPEG_SUPPORT
    bool "Motion JPEG Decoder Support"
    default n
    help
        when enabled, Motion JPEG stream decoder is supported

config HI_VDEC_USERDATA_CC_SUPPORT
    bool "CC or AFD Support"
    default y
    help
        when enabled, Closed Caption(CC) or Active Format Description(AFD) user data can be received

config HI_VDEC_USERDATA_CC_BUFSIZE
    hex "CC or AFD Buffer Size"
    depends on HI_VDEC_USERDATA_CC_SUPPORT
    range 0x4000 0x40000
    default 0xC000
    help
        Closed Caption(CC) or Active Format Description(AFD) user data buffer size, recommend: 0xC000

config HI_VDEC_SCD_BUFSIZE
    hex "SCD Buffer Size (KB)"
    depends on HI3716MV430
    default 0x600
    help
        SCD buffer size

config HI_VDEC_MAX_INSTANCE
    int "Video Decoder Max Instance Number(1~8)"
    depends on HI3716MV430
    range 1 8
    default 1 if !HI_MCE_SUPPORT
    default 2 if HI_MCE_SUPPORT
    help
        It is necessarily set to bigger than 1 to support mce-fastpaly.

config HI_VDEC_REG_CODEC_SUPPORT
    depends on HI3716MV430
    bool "External video decoder support"
    default n
    help
        when enabled, external video decoder could be registered
```

## scripts/kconfig/Kconfig.venc
```kconfig
config HI_VENC_SUPPORT
    bool
    depends on !(HI3716MV410 || HI3716MV430)
    default y
```

## scripts/kconfig/Kconfig.vi
```kconfig
config  HI_VI_SUPPORT
    bool "VI Support"
    depends on !(HI3716MV430)
    default n
    help
        video input for video phone case
```
